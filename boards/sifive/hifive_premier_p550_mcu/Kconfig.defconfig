## boards/sifive/hifive_premier_p550_mcu/Kconfig.defconfig
```kconfig
# hifive_premier_p550_mcu board configuration

# SPDX-FileCopyrightText: © 2025-2026 Tenstorrent AI ULC
# SPDX-License-Identifier: Apache-2.0

if BOARD_HIFIVE_PREMIER_P550_MCU

config SPI_STM32_INTERRUPT
	default y
	depends on SPI

if NETWORKING

config NET_L2_ETHERNET
	default y

endif # NETWORKING

endif # BOARD_HIFIVE_PREMIER_P550_MCU
```

## boards/sifive/hifive_premier_p550_mcu/Kconfig.hifive_premier_p550_mcu
```kconfig
# SPDX-FileCopyrightText: © 2025-2026 Tenstorrent AI ULC
# SPDX-License-Identifier: Apache-2.0

config BOARD_HIFIVE_PREMIER_P550_MCU
	select SOC_STM32F407XE
```

## boards/sifive/hifive_premier_p550_mcu/board.yml
```yaml
board:
  name: hifive_premier_p550_mcu
  full_name: SiFive HiFive Premier P550 MCU
  vendor: sifive
  socs:
    - name: stm32f407xx
```

## boards/sifive/hifive_premier_p550_mcu/hifive_premier_p550_mcu_defconfig
```kconfig
# SPDX-License-Identifier: Apache-2.0

# Redfish system overview (board-specific)
CONFIG_REDFISH_SYSTEM_PRODUCT_NAME="HiFive Premier P550"
CONFIG_REDFISH_SYSTEM_MANUFACTURER="SiFive"
CONFIG_REDFISH_SYSTEM_MODEL="HiFive Premier P550"
CONFIG_REDFISH_SYSTEM_PROCESSOR_MODEL="SiFive P550"
CONFIG_REDFISH_SYSTEM_PROCESSOR_COUNT=8
CONFIG_REDFISH_SYSTEM_MEMORY_GIB=16

# Enable MPU
CONFIG_ARM_MPU=y

# Enable HW stack protection
CONFIG_HW_STACK_PROTECTION=y

# Enable UART
CONFIG_SERIAL=y

# Console
CONFIG_CONSOLE=y
CONFIG_UART_CONSOLE=y

# Enable GPIO
CONFIG_GPIO=y
```

## src/Kconfig.power
```kconfig
# SPDX-License-Identifier: Apache-2.0
# SPDX-FileCopyrightText: © 2026 Red Hat, LLC
# Power sequencing and monitoring

config POWER_SEQUENCING
	bool "Hardware power sequencing state machine"
	default y
	depends on $(dt_alias_enabled,power-good)
	help
	  Enable multi-step power sequencing (ATX -> DC -> wait power good ->
	  SOM reset release -> power LED) instead of simple GPIO toggle.

config POWER_GOOD_TIMEOUT_MS
	int "Power-good wait timeout (ms)"
	default 2000
	depends on POWER_SEQUENCING

config POWER_GOOD_POLL_MS
	int "Power-good poll interval (ms)"
	default 200
	depends on POWER_SEQUENCING

config POWER_MONITOR
	bool "12V rail power monitoring (INA226)"
	default y
	depends on SENSOR
	depends on $(dt_nodelabel_enabled,ina226)
```

## src/eswin/Kconfig.board_identity
```kconfig
# SPDX-License-Identifier: Apache-2.0
# SPDX-FileCopyrightText: © 2026 Red Hat, LLC
# Carrier board identity from EEPROM

config BOARD_IDENTITY
	bool "Board identity from EEPROM"
	default y
	depends on EEPROM
	help
	  Read carrier board identity (serial number, MAC addresses,
	  PCB revision) from AT24C02C EEPROM on I2C1. Requires the
	  I2C mux (PA3) to route the shared bus to the MCU.
```

## src/eswin/Kconfig.bootsel
```kconfig
# SPDX-License-Identifier: Apache-2.0
# SPDX-FileCopyrightText: © 2026 Red Hat, LLC
# SOM boot mode selection (BOOT_SEL[3:0])

config BOOTSEL
	bool "SOM boot mode selection"
	default y
	depends on $(dt_alias_enabled,bootsel-0)
	help
	  Control the SOM boot source via BOOT_SEL[3:0] GPIO pins.
	  Supports hardware mode (follow DIP switch) and software mode
	  (MCU drives the pins).
```

## src/eswin/Kconfig.som_protocol
```kconfig
# SPDX-License-Identifier: Apache-2.0
# SPDX-FileCopyrightText: © 2026 Red Hat, LLC
# SOM-MCU UART protocol (UART4 ↔ SoC UART2)

config SOM_PROTOCOL
	bool "SOM-MCU UART4 communication protocol"
	default y
	depends on $(dt_nodelabel_enabled,uart4)
	select SERIAL
	select UART_INTERRUPT_DRIVEN
	help
	  Bidirectional framed protocol between the BMC (MCU UART4) and the
	  SoC (SoC UART2). Used for keepalive, PVT queries, and graceful
	  shutdown/restart coordination with the host-side somd daemon.

if SOM_PROTOCOL

config SOM_PROTOCOL_STACK_SIZE
	int "SOM protocol thread stack size"
	default 2048

config SOM_PROTOCOL_PRIORITY
	int "SOM protocol thread priority"
	default 5

config SOM_PROTOCOL_TX_TIMEOUT_MS
	int "SOM command response timeout (ms)"
	default 2000

config SOM_KEEPALIVE
	bool "SOM keepalive health monitor"
	default y

config SOM_KEEPALIVE_INTERVAL_MS
	int "Keepalive poll interval (ms)"
	default 1000
	depends on SOM_KEEPALIVE

config SOM_KEEPALIVE_FAIL_THRESHOLD
	int "Consecutive failures before marking SOM offline"
	default 5
	depends on SOM_KEEPALIVE

config SOM_KEEPALIVE_STACK_SIZE
	int "Keepalive thread stack size"
	default 1024
	depends on SOM_KEEPALIVE

config GRACEFUL_SHUTDOWN_TIMEOUT_MS
	int "Graceful shutdown timeout (ms)"
	default 60000
	help
	  Time to wait for SOM to send shutdown NOTIFY before forcing
	  power off. Linux shutdown can take 30+ seconds for service
	  stops and filesystem sync.

config GRACEFUL_REBOOT_TIMEOUT_MS
	int "Graceful reboot timeout (ms)"
	default 60000
	help
	  Time to wait for SOM to send reboot NOTIFY before forcing
	  reset. Linux reboot can take 30+ seconds.

endif # SOM_PROTOCOL
```
